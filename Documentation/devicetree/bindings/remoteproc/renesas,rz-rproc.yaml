## drivers/drp/Kconfig
```kconfig
#
# DRP subsystem configuration
#

menu "DRP/DRP support"

config DRP
	bool "DRP support"
	default y
	help
	  DRP is a peripheral hardware that accelerates image processing.
	  If you want DRP support, you should say Y here.

config DRP_SUPPORT_MULTI_OS
       bool "Support Multiple OS System"
       default n
       help
         If you want to use multiple OS system (assumed with RTOS), you should say Y here.

config DRP_INIT_SHARED_MEMORY
       bool "Initialize Shared Memory"
       default n
       help
         If you want to initialize shard memory, you should say Y here.
         When "Support Multiple OS System" is 'Y', this option is enable.
endmenu
```

## drivers/media/platform/renesas/v4h-cam-aggregator/Kconfig
```kconfig
# SPDX-License-Identifier: GPL-2.0

config VIDEO_RCAR_V4H_CAM_AGGREGATOR
	bool "R-Car V4H single-node camera for plain V4L2 applications"
	depends on V4L_PLATFORM_DRIVERS
	depends on VIDEO_DEV && OF && MEDIA_CONTROLLER
	depends on ARCH_RENESAS || COMPILE_TEST
	depends on VIDEO_RCAR_VIN=y && VIDEO_RCAR_ISP=y
	select VIDEO_V4L2_SUBDEV_API
	select VIDEOBUF2_VMALLOC
	default y
	help
	  The R-Car V4H camera is exposed as raw Bayer VIN nodes plus an ISP
	  that is driven from userspace (libcamera), so applications such as
	  VLC, which only open single-plane capture nodes, cannot show it.

	  This driver runs the VIN to ISP loop in the kernel and registers one
	  BGR32 capture node per enabled camera connector (J1: /dev/video21,
	  J2: /dev/video22) with the result. It
	  finds the camera itself (Raspberry Pi Camera v2 imx219 or v3 imx708),
	  sets the pipeline formats and regulates exposure, gain and white
	  balance from the picture. While the node streams, libcamera cannot
	  use the camera.

	  The driver is always built into the kernel, so /dev/video21 is there
	  after boot without loading anything.
```
