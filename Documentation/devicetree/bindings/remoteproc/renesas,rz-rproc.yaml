## Documentation/devicetree/bindings/remoteproc/renesas,rz-rproc.yaml
```yaml
# SPDX-License-Identifier: (GPL-2.0 OR BSD-2-Clause)
%YAML 1.2
---
$id: http://devicetree.org/schemas/remoteproc/renesas,rz-rproc.yaml#
$schema: http://devicetree.org/meta-schemas/core.yaml#

title: Renesas RZ remote processor controller

maintainers:
  - Tu Duong <tu.duong.zy@renesas.com>
  - Tien Nguyen <tien.nguyen.uh@renesas.com>

description:
  This document defines the binding for the remoteproc component that loads
  and boots firmwares on the Renesas RZ SoC family (RZ/G2L, RZ/V2L, RZ/V2H).
  Supported remote cores are Cortex-M33 (CM33) and Cortex-R8 (CR8, RZ/V2H
  only).

properties:
  compatible:
    enum:
      - renesas,rzg2l-cm33
      - renesas,rzv2h-cm33
      - renesas,rzv2h-cr8

  reg:
    description:
      Address ranges of the SRAM and DDR memories used by the remote processor.
    maxItems: 3

  reg-names:
    maxItems: 3

  memory-region:
    description:
      List of phandles to the reserved memory regions associated with the
      remoteproc device. This describes the memories shared with the remote
      processor (e.g. remoteproc firmware and carveouts, rpmsg vrings).
      See ../reserved-memory/reserved-memory.txt.

  renesas,rz-cpg:
    $ref: /schemas/types.yaml#/definitions/phandle
    description: phandle to the Clock Pulse Generator (CPG) syscon regmap.

  renesas,rz-sysc:
    $ref: /schemas/types.yaml#/definitions/phandle
    description: phandle to the System Controller (SYSC) syscon regmap.

  renesas,rz-core:
    $ref: /schemas/types.yaml#/definitions/uint32
    description: |
      Core identifier for RZ/V2H multi-core support.
        0 = Cortex-M33
        1 = Cortex-R8 core 0
        2 = Cortex-R8 core 1
    enum: [0, 1, 2]

  renesas,rz-bootaddrs:
    $ref: /schemas/types.yaml#/definitions/uint32-array
    description: |
      Boot vector addresses for the remote processor.
        1st cell: secure vector address
        2nd cell: non-secure vector address
    minItems: 2
    maxItems: 2

  renesas,rz-autoboot:
    $ref: /schemas/types.yaml#/definitions/flag
    description:
      If defined, when remoteproc is probed it loads the default firmware and
      starts the remote processor automatically.

  renesas,rz-rsctbl:
    $ref: /schemas/types.yaml#/definitions/uint32
    description:
      Physical address of the resource table. When the remote processor is
      already powered up by u-boot or op-tee, this value is used to locate
      and parse the loaded resource table.

  clocks:
    maxItems: 2

  clock-names:
    maxItems: 2

  resets:
    maxItems: 3

  reset-names:
    description: |
      Reset line names. Must match the SoC-specific DT binding:
        RZ/G2L CM33: "nporeset", "nsysreset", "miscresetn"
        RZ/V2H CM33: "cm33reset0", "cm33reset1", "cm33reset2"
        RZ/V2H CR8:  no reset controls in DT (num_resets = 0)
    maxItems: 3

  power-domains:
    maxItems: 1

  status:
    description: Standard DT status property.

required:
  - compatible
  - memory-region
  - renesas,rz-cpg
  - renesas,rz-sysc

allOf:
  # CM33 cores (both RZ/G2L and RZ/V2H) require boot addresses
  - if:
      properties:
        compatible:
          contains:
            enum:
              - renesas,rzg2l-cm33
              - renesas,rzv2h-cm33
    then:
      required:
        - renesas,rz-bootaddrs
        - resets
        - reset-names
        - power-domains

  # RZ/G2L CM33 additionally requires clocks
  - if:
      properties:
        compatible:
          contains:
            enum:
              - renesas,rzg2l-cm33
    then:
      required:
        - clocks
        - clock-names

  # RZ/V2H cores require renesas,rz-core to identify which core this node is
  - if:
      properties:
        compatible:
          contains:
            enum:
              - renesas,rzv2h-cm33
              - renesas,rzv2h-cr8
    then:
      required:
        - renesas,rz-core

additionalProperties: false

examples:
  # RZ/G2L CM33 example
  - |
    #include <dt-bindings/clock/r9a07g044-cpg.h>

    reserved-memory {
        #address-cells = <2>;
        #size-cells = <2>;
        ranges;

        vdev0vring0: vdev0vring0@43000000 {
            compatible = "shared-dma-pool";
            reg = <0x0 0x43000000 0x0 0x50000>;
            no-map;
        };

        vdev0vring1: vdev0vring1@43050000 {
            compatible = "shared-dma-pool";
            reg = <0x0 0x43050000 0x0 0x50000>;
            no-map;
        };

        vdev0buffer: vdev0buffer@43200000 {
            compatible = "shared-dma-pool";
            reg = <0x0 0x43200000 0x0 0x300000>;
            no-map;
        };
    };

    cm33_rproc: cm33 {
        compatible = "renesas,rzg2l-cm33";
        reg = <0x0 0x08000000 0x0 0x00100000>,
              <0x0 0x40010000 0x0 0x3EF0000>;
        reg-names = "cm33_sram", "cm33_ddr";
        memory-region = <&vdev0vring0>, <&vdev0vring1>, <&vdev0buffer>;
        renesas,rz-cpg = <&cpg>;
        renesas,rz-sysc = <&sys>;
        renesas,rz-bootaddrs = <0x08003000 0x18003000>;
        renesas,rz-rsctbl = <0x42F00000>;
        clocks = <&cpg CPG_MOD 0x12>;
        clock-names = "cm33clk0";
        resets = <&cpg 0x13>,
                 <&cpg 0x14>,
                 <&cpg 0x15>;
        reset-names = "nporeset", "nsysreset", "miscresetn";
        power-domains = <&cpg>;
        status = "okay";
    };

  # RZ/V2H CM33 example
  - |
    #include <dt-bindings/clock/r9a09g057-cpg.h>

    cm33_rproc_v2h: cm33 {
        compatible = "renesas,rzv2h-cm33";
        reg = <0x0 0x08000000 0x0 0x00100000>,
              <0x0 0x80000000 0x0 0x10000000>;
        reg-names = "cm33_sram", "cm33_ddr";
        memory-region = <&vdev0vring0>, <&vdev0vring1>, <&vdev0buffer>;
        renesas,rz-cpg = <&cpg>;
        renesas,rz-sysc = <&sys>;
        renesas,rz-core = <0>;
        renesas,rz-bootaddrs = <0x08003000 0x18003000>;
        resets = <&cpg 0x20>,
                 <&cpg 0x21>,
                 <&cpg 0x22>;
        reset-names = "cm33reset0", "cm33reset1", "cm33reset2";
        power-domains = <&cpg>;
        status = "okay";
    };

  # RZ/V2H CR8 core 0 example
  - |
    #include <dt-bindings/clock/r9a09g057-cpg.h>

    cr8_core0_rproc: cr8-core0 {
        compatible = "renesas,rzv2h-cr8";
        reg = <0x0 0x12040000 0x0 0x40000>,
              <0x0 0xC0000000 0x0 0x10000000>;
        reg-names = "cr8_tcm", "cr8_ddr";
        memory-region = <&cr8_vdev0vring0>, <&cr8_vdev0vring1>,
                        <&cr8_vdev0buffer>;
        renesas,rz-cpg = <&cpg>;
        renesas,rz-sysc = <&sys>;
        renesas,rz-core = <1>;
        status = "okay";
    };
```
