// SPDX-License-Identifier: GPL-2.0+
/*
 * Copyright (C) 2023 Renesas Electronics Corporation
 */

/dts-v1/;
/plugin/;

#include <dt-bindings/pinctrl/rzg2l-pinctrl.h>

/* 40-pin extended GPIO, expanded into UART, SPI, I2C, PWM and other interfaces */
&pinctrl {
	spi0_pins: spi0 {
		pinmux = <RZG2L_PORT_PINMUX(43, 0, 1)>, /* CK */
			 <RZG2L_PORT_PINMUX(43, 1, 1)>, /* MOSI */
			 <RZG2L_PORT_PINMUX(43, 2, 1)>, /* MISO */
			 <RZG2L_PORT_PINMUX(43, 3, 1)>; /* SSL */
	};
};

&spi0 {
	pinctrl-0 = <&spi0_pins>;
	pinctrl-names = "default";
	dmas = <&dmac 0x2e95>, <&dmac 0x2e96>;
	dma-names = "tx", "rx";
	status = "okay";

	#address-cells = <1>;
	#size-cells = <0>;

	spidev@0 {
		compatible = "semtech,sx1301";
		reg = <0>;
		spi-max-frequency = <2000000>;
	};
};
